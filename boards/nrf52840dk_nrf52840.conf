## boards/nrf52840dk_nrf52840.conf
```kconfig
CONFIG_I2C=y
CONFIG_NRFX_TWIS1=y

# Using hardware crypto accelerator
CONFIG_PSA_CRYPTO_DRIVER_CC3XX=y

# Use TRUSTED_STORAGE because this is a secure-only board
CONFIG_TRUSTED_STORAGE=y
CONFIG_TRUSTED_STORAGE_STORAGE_BACKEND_SETTINGS=y

CONFIG_NVS=y
CONFIG_SETTINGS_NVS=y
```
